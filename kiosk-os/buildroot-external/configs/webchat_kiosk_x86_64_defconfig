## kiosk-os/buildroot-external/configs/webchat_kiosk_x86_64_defconfig
```kconfig
BR2_x86_64=y
BR2_TOOLCHAIN_BUILDROOT_GLIBC=y
BR2_TOOLCHAIN_BUILDROOT_CXX=y
BR2_KERNEL_HEADERS_6_6=y
BR2_INIT_BUSYBOX=y
BR2_SYSTEM_DHCP="eth0"
BR2_TARGET_GENERIC_HOSTNAME="webchat-kiosk"
BR2_TARGET_GENERIC_ISSUE="Webchat Kiosk OS"
BR2_ROOTFS_OVERLAY="$(BR2_EXTERNAL_WEBCHAT_KIOSK_PATH)/board/webchat/kiosk/rootfs-overlay"
BR2_ROOTFS_POST_BUILD_SCRIPT="$(BR2_EXTERNAL_WEBCHAT_KIOSK_PATH)/board/webchat/kiosk/post-build.sh"
BR2_ROOTFS_POST_IMAGE_SCRIPT="$(BR2_EXTERNAL_WEBCHAT_KIOSK_PATH)/board/webchat/kiosk/post-image.sh"
BR2_ROOTFS_POST_SCRIPT_ARGS="$(BINARIES_DIR)"
BR2_LINUX_KERNEL=y
BR2_LINUX_KERNEL_CUSTOM_VERSION=y
BR2_LINUX_KERNEL_CUSTOM_VERSION_VALUE="6.6.57"
BR2_LINUX_KERNEL_USE_CUSTOM_CONFIG=y
BR2_LINUX_KERNEL_CUSTOM_CONFIG_FILE="$(BR2_EXTERNAL_WEBCHAT_KIOSK_PATH)/board/webchat/kiosk/linux.config"
BR2_LINUX_KERNEL_NEEDS_HOST_OPENSSL=y
BR2_PACKAGE_BUSYBOX_SHOW_OTHERS=y
BR2_PACKAGE_EUDEV=y
BR2_PACKAGE_IFUPDOWN_SCRIPTS=y
BR2_PACKAGE_WPA_SUPPLICANT=y
BR2_PACKAGE_IWD=y
BR2_PACKAGE_TZDATA=y
BR2_PACKAGE_DBUS=y
BR2_PACKAGE_LIBDRM=y
BR2_PACKAGE_MESA3D=y
BR2_PACKAGE_WESTON=y
BR2_PACKAGE_WESTON_INIT=y
BR2_PACKAGE_CHROMIUM=y
BR2_PACKAGE_CHROMIUM_WAYLAND=y
BR2_PACKAGE_XKEYBOARD_CONFIG=y
BR2_PACKAGE_FONTCONFIG=y
BR2_PACKAGE_DEJAVU=y
BR2_PACKAGE_NSS=y
BR2_PACKAGE_CA_CERTIFICATES=y
BR2_TARGET_ROOTFS_SQUASHFS=y
BR2_TARGET_ROOTFS_EXT2=y
BR2_TARGET_ROOTFS_EXT2_4=y
BR2_TARGET_ROOTFS_EXT2_LABEL="WEBCHAT_OS"
BR2_TARGET_GRUB2=y
BR2_TARGET_GRUB2_X86_64_EFI=y
BR2_TARGET_GRUB2_BOOT_PARTITION="EFI"
BR2_TARGET_GRUB2_BUILTIN_CONFIG="$(BR2_EXTERNAL_WEBCHAT_KIOSK_PATH)/board/webchat/kiosk/grub-efi.cfg"
BR2_PACKAGE_HOST_DOSFSTOOLS=y
BR2_PACKAGE_HOST_GENIMAGE=y
BR2_PACKAGE_HOST_MTOOLS=y
BR2_PACKAGE_HOST_XORRISO=y
```
